## HPF-mspi/build_xiao/HPF-mspi/Kconfig/boards/Kconfig.xiao_nrf54l15
```kconfig
# Load board Kconfig descriptions.
osource "C:/ncs/v3.1.1/zephyr/boards/arm/xiao_nrf54l15/Kconfig.xiao_nrf54l15"
```

## HPF-mspi/build_xiao/vpr_launcher/Kconfig/arch/Kconfig
```kconfig
# Load Zephyr Arch Kconfig descriptions.
osource "C:/ncs/v3.1.1/zephyr/arch/rx/Kconfig"
osource "C:/ncs/v3.1.1/zephyr/arch/x86/Kconfig"
osource "C:/ncs/v3.1.1/zephyr/arch/xtensa/Kconfig"
osource "C:/ncs/v3.1.1/zephyr/arch/sparc/Kconfig"
osource "C:/ncs/v3.1.1/zephyr/arch/riscv/Kconfig"
osource "C:/ncs/v3.1.1/zephyr/arch/posix/Kconfig"
osource "C:/ncs/v3.1.1/zephyr/arch/mips/Kconfig"
osource "C:/ncs/v3.1.1/zephyr/arch/arm64/Kconfig"
osource "C:/ncs/v3.1.1/zephyr/arch/arm/Kconfig"
osource "C:/ncs/v3.1.1/zephyr/arch/arc/Kconfig"
```

## battery/build_xiao/Kconfig/boards/Kconfig.defconfig
```kconfig
# Load Zephyr board defconfig descriptions.
osource "C:/ncs/v3.1.0/zephyr/boards/seeed/xiao_nrf54l15/Kconfig.defconfig"
```

## battery/build_xiao/zephyr-battery-ncs/Kconfig/arch/Kconfig
```kconfig
# Load Zephyr Arch Kconfig descriptions.
osource "C:/ncs/v3.1.0/zephyr/arch/rx/Kconfig"
osource "C:/ncs/v3.1.0/zephyr/arch/x86/Kconfig"
osource "C:/ncs/v3.1.0/zephyr/arch/xtensa/Kconfig"
osource "C:/ncs/v3.1.0/zephyr/arch/sparc/Kconfig"
osource "C:/ncs/v3.1.0/zephyr/arch/riscv/Kconfig"
osource "C:/ncs/v3.1.0/zephyr/arch/posix/Kconfig"
osource "C:/ncs/v3.1.0/zephyr/arch/mips/Kconfig"
osource "C:/ncs/v3.1.0/zephyr/arch/arm64/Kconfig"
osource "C:/ncs/v3.1.0/zephyr/arch/arm/Kconfig"
osource "C:/ncs/v3.1.0/zephyr/arch/arc/Kconfig"
```

## ble_button/sample.yaml
```yaml
sample:
  description: BLE button sample for XIAO nRF54L15 - button press counter in advertising data
  name: BLE Button Sample
common:
  tags: bluetooth ble advertising gpio button
  harness: bluetooth
  platform_allow: xiao_nrf54l15/nrf54l15/cpuapp
  integration_platforms:
    - xiao_nrf54l15/nrf54l15/cpuapp
tests:
  sample.bluetooth.ble_button:
    harness: bluetooth
    platform_allow: xiao_nrf54l15/nrf54l15/cpuapp
```

## blink/build_debug/blink/Kconfig/boards/Kconfig.defconfig
```kconfig
# Load Zephyr board defconfig descriptions.
osource "C:/ncs/v3.2.0-preview2/zephyr/boards/seeed/xiao_nrf54l15/Kconfig.defconfig"
```

## blink/build_debug/blink/Kconfig/boards/Kconfig.xiao_nrf54l15
```kconfig
# Load board Kconfig descriptions.
osource "C:/ncs/v3.2.0-preview2/zephyr/boards/seeed/xiao_nrf54l15/Kconfig.xiao_nrf54l15"
```

## bluetooth/bap_broadcast_sink/boards/nrf52840dongle_nrf52840.conf
```kconfig
# Enable USB Audio for audio output
CONFIG_USE_USB_AUDIO_OUTPUT=y

# Enable NEW USB device stack and DISABLE old deprecated one
CONFIG_USB_DEVICE_STACK=n
CONFIG_USB_DEVICE_STACK_NEXT=y
CONFIG_USB_DEVICE_PRODUCT="BAP Broadcast Sink Audio"

# Disable serial console when using USB audio
CONFIG_BOARD_SERIAL_BACKEND_CDC_ACM=n
CONFIG_UART_CONSOLE=n
CONFIG_CONSOLE=n
CONFIG_SERIAL=n
CONFIG_UART_INTERRUPT_DRIVEN=n
CONFIG_UART_LINE_CTRL=n

# Deferred logging so USB doesn't block
CONFIG_LOG_MODE_DEFERRED=y
```

## bluetooth/bap_dmic/boards/xiao_nrf54l15_nrf54l15_cpuapp.conf
```kconfig
# XIAO nRF54L15 Board Configuration for BAP Broadcast Source with PDM

# Bluetooth Controller Configuration for nRF54L15
CONFIG_BT=y
CONFIG_BT_LL_SOFTDEVICE=n
CONFIG_BT_LL_SW_SPLIT=y
CONFIG_BT_HCI=y

# Enable Extended Advertising for larger advertising data
CONFIG_BT_EXT_ADV=y
CONFIG_BT_EXT_ADV_MAX_ADV_SET=1

# Enable Audio DMIC (PDM) driver
# XIAO nRF54L15 DMIC Sample Board Configuration

CONFIG_AUDIO=y
CONFIG_AUDIO_DMIC=y

CONFIG_LOG=y
# Reduce log overhead to prevent message drops
CONFIG_LOG_DEFAULT_LEVEL=2
CONFIG_LOG_BUFFER_SIZE=2048

CONFIG_ISO_PACKING_INTERLEAVED=y

# Enable GPIO for LED status (optional)
CONFIG_GPIO=y

# Increase stack sizes for audio processing
CONFIG_MAIN_STACK_SIZE=4096
CONFIG_SYSTEM_WORKQUEUE_STACK_SIZE=2048

# Console output via UART21
CONFIG_UART_CONSOLE=y
CONFIG_CONSOLE=y
CONFIG_SERIAL=y
```

## bluetooth/ble/Kconfig.sysbuild
```kconfig
source "${ZEPHYR_BASE}/share/sysbuild/Kconfig"

config NRF_DEFAULT_IPC_RADIO
	default y

config NETCORE_IPC_RADIO_BT_HCI_IPC
	default y
```

## bluetooth/bluepad32_zephyr/sample.yaml
```yaml
sample:
  name: Bluepad32 for Zephyr
  description: Bluetooth gamepad/controller library ported to Zephyr RTOS
tests:
  sample.bluepad32.basic:
    harness: console
    tags: bluetooth
    integration_platforms:
      - xiao_nrf54l15/nrf54l15/cpuapp
      - nrf52840dk/nrf52840
      - nrf5340dk/nrf5340/cpuapp
    platform_allow:
      - xiao_nrf54l15/nrf54l15/cpuapp
      - nrf52840dk/nrf52840
      - nrf5340dk/nrf5340/cpuapp
```

## channel_sounding/connected_cs/initiator/build_dk/Kconfig/boards/Kconfig
```kconfig
# Load Zephyr board Kconfig descriptions.
osource "C:/ncs/v3.1.1/zephyr/boards/nordic/nrf54l15dk/Kconfig"
```

## channel_sounding/connected_cs/initiator/build_dk/initiator/Kconfig/boards/Kconfig.defconfig
```kconfig
# Load Zephyr board defconfig descriptions.
osource "C:/ncs/v3.1.1/zephyr/boards/nordic/nrf54l15dk/Kconfig.defconfig"
```

## channel_sounding/connected_cs/initiator/build_dk/initiator/Kconfig/boards/Kconfig.nrf54l15dk
```kconfig
# Load board Kconfig descriptions.
osource "C:/ncs/v3.1.1/zephyr/boards/nordic/nrf54l15dk/Kconfig.nrf54l15dk"
```

## dmic/boards/xiao_nrf54l15_nrf54l15_cpuapp.conf
```kconfig
# XIAO nRF54L15 DMIC Sample Board Configuration
CONFIG_GPIO=y
CONFIG_AUDIO=y
CONFIG_AUDIO_DMIC=y

CONFIG_LOG=y
# Reduce log overhead to prevent message drops
CONFIG_LOG_DEFAULT_LEVEL=2
CONFIG_LOG_BUFFER_SIZE=2048
```

## dmic/sample.yaml
```yaml
sample:
  name: Digital Microphone (DMIC) Audio
  description: PDM digital microphone audio capture using DMIC driver
tests:
  sample.audio.dmic:
    harness: console
    platform_allow:
      - nrf52840dk/nrf52840
      - nrf5340dk/nrf5340/cpuapp
      - xiao_nrf54l15/nrf54l15/cpuapp
    tags: audio dmic pdm microphone
    integration_platforms:
      - xiao_nrf54l15/nrf54l15/cpuapp
```

## dmic_ble/boards/xiao_nrf54l15_nrf54l15_cpuapp.conf
```kconfig
# ----------------- Core hardware -----------------
CONFIG_GPIO=y
CONFIG_AUDIO=y
CONFIG_AUDIO_DMIC=y

# ----------------- Logging -----------------
CONFIG_LOG=y
CONFIG_LOG_DEFAULT_LEVEL=2
CONFIG_LOG_BUFFER_SIZE=2048
CONFIG_CONSOLE=y

# ----------------- Bluetooth Core -----------------
CONFIG_BT=y
CONFIG_BT_PERIPHERAL=y
CONFIG_BT_DEVICE_NAME="nRF54L15 Mic"
CONFIG_BT_MAX_CONN=1
CONFIG_BT_MAX_PAIRED=1
CONFIG_BT_GATT_CLIENT=y
CONFIG_BT_GATT_SERVICE_CHANGED=y
CONFIG_BT_SETTINGS=y
CONFIG_SETTINGS=y

# ----------------- LE Audio stack -----------------
CONFIG_BT_AUDIO=y
CONFIG_BT_BAP_UNICAST_SERVER=y       # Device can host a unicast stream
CONFIG_BT_BAP_UNICAST_SRC=y          # We’re a microphone (audio source)
CONFIG_BT_BAP_LC3_SUPPORT=y          # Enable LC3 codec support
CONFIG_BT_PAC_SRC=y                  # Publish audio capabilities as source
CONFIG_BT_AUDIO_CAP_ACCEPTOR=y       # Allow remote (PC) to start audio

# ----------------- LC3 codec -----------------
CONFIG_AUDIO_CODEC_LC3=y
CONFIG_LC3_ENCODER=y
CONFIG_LC3_SAMPLE_RATE=16000
CONFIG_LC3_BITRATE=32000
CONFIG_LC3_ENCODE_FRAME_US=10000     # 10 ms frame, 16 kHz mono

# ----------------- Optional control (volume) -----------------
CONFIG_BT_VCP_VOL_REND=y

# ----------------- Stack / memory tuning -----------------
CONFIG_MAIN_STACK_SIZE=4096
CONFIG_SYSTEM_WORKQUEUE_STACK_SIZE=4096
CONFIG_BT_RX_STACK_SIZE=4096
CONFIG_BT_BUF_ACL_TX_SIZE=251
CONFIG_BT_BUF_ACL_RX_SIZE=251

# ----------------- Power -----------------
CONFIG_PM=y
CONFIG_PM_DEVICE=y
```

## epaper/sample.yaml
```yaml
sample:
  name: E-Paper Display
  description: E-Paper display sample using LVGL graphics library
tests:
  sample.display.epaper:
    harness: console
    platform_allow:
      - nrf52840dk/nrf52840
      - nrf5340dk/nrf5340/cpuapp
      - xiao_nrf54l15/nrf54l15/cpuapp
    tags: display epaper lvgl gui
    integration_platforms:
      - xiao_nrf54l15/nrf54l15/cpuapp
```

## gps/build_xiao/zephyr-gps-ncs/Kconfig/boards/Kconfig
```kconfig
# Load Zephyr board Kconfig descriptions.
osource "C:/ncs/v3.1.0/zephyr/boards/seeed/xiao_nrf54l15/Kconfig"
```

## hci_uart/build_dk/hci_uart/Kconfig/boards/Kconfig.defconfig
```kconfig
# Load Zephyr board defconfig descriptions.
osource "C:/ncs/v3.1.0/zephyr/boards/nordic/nrf54l15dk/Kconfig.defconfig"
```

## hci_uart/build_dk/hci_uart/Kconfig/boards/Kconfig.sysbuild
```kconfig
# Load Sysbuild board Kconfig descriptions.
osource "C:/ncs/v3.1.0/zephyr/boards/nordic/nrf54l15dk/Kconfig.sysbuild"
```

## hpf/blinky_hpf/build_dk/blinky_hpf/Kconfig/soc/Kconfig
```kconfig
# Load Zephyr SoC Kconfig descriptions.
osource "C:/ncs/v3.2.0-preview2/zephyr/soc/xlnx/zynqmp/Kconfig"
osource "C:/ncs/v3.2.0-preview2/zephyr/soc/xlnx/zynq7000/Kconfig"
osource "C:/ncs/v3.2.0-preview2/zephyr/soc/xlnx/versalnet/Kconfig"
osource "C:/ncs/v3.2.0-preview2/zephyr/soc/xlnx/versal2/Kconfig"
osource "C:/ncs/v3.2.0-preview2/zephyr/soc/xen/Kconfig"
osource "C:/ncs/v3.2.0-preview2/zephyr/soc/wch/ch32v/Kconfig"
osource "C:/ncs/v3.2.0-preview2/zephyr/soc/ti/simplelink/Kconfig"
osource "C:/ncs/v3.2.0-preview2/zephyr/soc/ti/mspm0/Kconfig"
osource "C:/ncs/v3.2.0-preview2/zephyr/soc/ti/lm3s6965/Kconfig"
osource "C:/ncs/v3.2.0-preview2/zephyr/soc/ti/k3/Kconfig"
osource "C:/ncs/v3.2.0-preview2/zephyr/soc/telink/tlsr/Kconfig"
osource "C:/ncs/v3.2.0-preview2/zephyr/soc/starfive/jh71xx/Kconfig"
osource "C:/ncs/v3.2.0-preview2/zephyr/soc/st/stm32/Kconfig"
osource "C:/ncs/v3.2.0-preview2/zephyr/soc/snps/qemu_arc/Kconfig"
osource "C:/ncs/v3.2.0-preview2/zephyr/soc/snps/nsim/arc_v/Kconfig"
osource "C:/ncs/v3.2.0-preview2/zephyr/soc/snps/nsim/arc_classic/Kconfig"
osource "C:/ncs/v3.2.0-preview2/zephyr/soc/snps/hsdk4xd/Kconfig"
osource "C:/ncs/v3.2.0-preview2/zephyr/soc/snps/hsdk/Kconfig"
osource "C:/ncs/v3.2.0-preview2/zephyr/soc/snps/emsk/Kconfig"
osource "C:/ncs/v3.2.0-preview2/zephyr/soc/snps/emsdp/Kconfig"
osource "C:/ncs/v3.2.0-preview2/zephyr/soc/snps/arc_iot/Kconfig"
osource "C:/ncs/v3.2.0-preview2/zephyr/soc/silabs/Kconfig"
osource "C:/ncs/v3.2.0-preview2/zephyr/soc/sifive/sifive_freedom/Kconfig"
osource "C:/ncs/v3.2.0-preview2/zephyr/soc/sensry/Kconfig"
osource "C:/ncs/v3.2.0-preview2/zephyr/soc/rockchip/Kconfig"
osource "C:/ncs/v3.2.0-preview2/zephyr/soc/renode/riscv_virtual/Kconfig"
osource "C:/ncs/v3.2.0-preview2/zephyr/soc/renode/cortex_r8_virtual/Kconfig"
osource "C:/ncs/v3.2.0-preview2/zephyr/soc/renesas/smartbond/Kconfig"
osource "C:/ncs/v3.2.0-preview2/zephyr/soc/renesas/rz/Kconfig"
osource "C:/ncs/v3.2.0-preview2/zephyr/soc/renesas/rx/Kconfig"
osource "C:/ncs/v3.2.0-preview2/zephyr/soc/renesas/rcar/Kconfig"
osource "C:/ncs/v3.2.0-preview2/zephyr/soc/renesas/ra/Kconfig"
osource "C:/ncs/v3.2.0-preview2/zephyr/soc/realtek/ec/Kconfig"
osource "C:/ncs/v3.2.0-preview2/zephyr/soc/raspberrypi/rpi_pico/Kconfig"
osource "C:/ncs/v3.2.0-preview2/zephyr/soc/quicklogic/eos_s3/Kconfig"
osource "C:/ncs/v3.2.0-preview2/zephyr/soc/qemu/virt_riscv/Kconfig"
osource "C:/ncs/v3.2.0-preview2/zephyr/soc/qemu/malta/Kconfig"
osource "C:/ncs/v3.2.0-preview2/zephyr/soc/openisa/rv32m1/Kconfig"
osource "C:/ncs/v3.2.0-preview2/zephyr/soc/openhwgroup/cva6/Kconfig"
osource "C:/ncs/v3.2.0-preview2/zephyr/soc/oct/osd32mp15x/Kconfig"
osource "C:/ncs/v3.2.0-preview2/zephyr/soc/nxp/s32/Kconfig"
osource "C:/ncs/v3.2.0-preview2/zephyr/soc/nxp/rw/Kconfig"
osource "C:/ncs/v3.2.0-preview2/zephyr/soc/nxp/mcx/Kconfig"
osource "C:/ncs/v3.2.0-preview2/zephyr/soc/nxp/lpc/Kconfig"
osource "C:/ncs/v3.2.0-preview2/zephyr/soc/nxp/layerscape/Kconfig"
osource "C:/ncs/v3.2.0-preview2/zephyr/soc/nxp/kinetis/Kconfig"
osource "C:/ncs/v3.2.0-preview2/zephyr/soc/nxp/imxrt/Kconfig"
osource "C:/ncs/v3.2.0-preview2/zephyr/soc/nxp/imx/Kconfig"
osource "C:/ncs/v3.2.0-preview2/zephyr/soc/nuvoton/numicro/Kconfig"
osource "C:/ncs/v3.2.0-preview2/zephyr/soc/nuvoton/numaker/Kconfig"
osource "C:/ncs/v3.2.0-preview2/zephyr/soc/nuvoton/npcx/Kconfig"
osource "C:/ncs/v3.2.0-preview2/zephyr/soc/nuvoton/npcm/Kconfig"
osource "C:/ncs/v3.2.0-preview2/zephyr/soc/nordic/Kconfig"
osource "C:/ncs/v3.2.0-preview2/zephyr/soc/neorv32/Kconfig"
osource "C:/ncs/v3.2.0-preview2/zephyr/soc/native/inf_clock/Kconfig"
osource "C:/ncs/v3.2.0-preview2/zephyr/soc/microchip/sam/Kconfig"
osource "C:/ncs/v3.2.0-preview2/zephyr/soc/microchip/sam/sam_d5x_e5x/Kconfig"
osource "C:/ncs/v3.2.0-preview2/zephyr/soc/microchip/miv/Kconfig"
osource "C:/ncs/v3.2.0-preview2/zephyr/soc/microchip/mec/Kconfig"
osource "C:/ncs/v3.2.0-preview2/zephyr/soc/mediatek/mt8xxx/Kconfig"
osource "C:/ncs/v3.2.0-preview2/zephyr/soc/lowrisc/opentitan/Kconfig"
osource "C:/ncs/v3.2.0-preview2/zephyr/soc/litex/litex_vexriscv/Kconfig"
osource "C:/ncs/v3.2.0-preview2/zephyr/soc/ite/ec/Kconfig"
osource "C:/ncs/v3.2.0-preview2/zephyr/soc/intel/raptor_lake/Kconfig"
osource "C:/ncs/v3.2.0-preview2/zephyr/soc/intel/panther_lake/Kconfig"
osource "C:/ncs/v3.2.0-preview2/zephyr/soc/intel/lakemont/Kconfig"
osource "C:/ncs/v3.2.0-preview2/zephyr/soc/intel/intel_socfpga_std/Kconfig"
osource "C:/ncs/v3.2.0-preview2/zephyr/soc/intel/intel_socfpga/Kconfig"
osource "C:/ncs/v3.2.0-preview2/zephyr/soc/intel/intel_niosv/Kconfig"
osource "C:/ncs/v3.2.0-preview2/zephyr/soc/intel/intel_ish/Kconfig"
osource "C:/ncs/v3.2.0-preview2/zephyr/soc/intel/intel_adsp/Kconfig"
osource "C:/ncs/v3.2.0-preview2/zephyr/soc/intel/elkhart_lake/Kconfig"
osource "C:/ncs/v3.2.0-preview2/zephyr/soc/intel/atom/Kconfig"
osource "C:/ncs/v3.2.0-preview2/zephyr/soc/intel/apollo_lake/Kconfig"
osource "C:/ncs/v3.2.0-preview2/zephyr/soc/intel/alder_lake/Kconfig"
osource "C:/ncs/v3.2.0-preview2/zephyr/soc/infineon/cat3/Kconfig"
osource "C:/ncs/v3.2.0-preview2/zephyr/soc/infineon/cat1c/Kconfig"
osource "C:/ncs/v3.2.0-preview2/zephyr/soc/infineon/cat1b/Kconfig"
osource "C:/ncs/v3.2.0-preview2/zephyr/soc/infineon/cat1a/Kconfig"
osource "C:/ncs/v3.2.0-preview2/zephyr/soc/gd/gd32/Kconfig"
osource "C:/ncs/v3.2.0-preview2/zephyr/soc/gaisler/leon3/Kconfig"
osource "C:/ncs/v3.2.0-preview2/zephyr/soc/gaisler/gr716a/Kconfig"
osource "C:/ncs/v3.2.0-preview2/zephyr/soc/espressif/Kconfig"
osource "C:/ncs/v3.2.0-preview2/zephyr/soc/ene/kb1200/Kconfig"
osource "C:/ncs/v3.2.0-preview2/zephyr/soc/ene/kb106x/Kconfig"
osource "C:/ncs/v3.2.0-preview2/zephyr/soc/efinix/sapphire/Kconfig"
osource "C:/ncs/v3.2.0-preview2/zephyr/soc/cdns/xtensa_sample_controller/Kconfig"
osource "C:/ncs/v3.2.0-preview2/zephyr/soc/cdns/sample_controller32/Kconfig"
osource "C:/ncs/v3.2.0-preview2/zephyr/soc/cdns/dc233c/Kconfig"
osource "C:/ncs/v3.2.0-preview2/zephyr/soc/brcm/bcmvk/Kconfig"
osource "C:/ncs/v3.2.0-preview2/zephyr/soc/brcm/bcm2712/Kconfig"
osource "C:/ncs/v3.2.0-preview2/zephyr/soc/brcm/bcm2711/Kconfig"
osource "C:/ncs/v3.2.0-preview2/zephyr/soc/bflb/Kconfig"
osource "C:/ncs/v3.2.0-preview2/zephyr/soc/atmel/sam0/Kconfig"
osource "C:/ncs/v3.2.0-preview2/zephyr/soc/atmel/sam/Kconfig"
osource "C:/ncs/v3.2.0-preview2/zephyr/soc/aspeed/Kconfig"
osource "C:/ncs/v3.2.0-preview2/zephyr/soc/arm/Kconfig"
osource "C:/ncs/v3.2.0-preview2/zephyr/soc/arm/beetle/Kconfig"
osource "C:/ncs/v3.2.0-preview2/zephyr/soc/antmicro/myra/Kconfig"
osource "C:/ncs/v3.2.0-preview2/zephyr/soc/andestech/Kconfig"
osource "C:/ncs/v3.2.0-preview2/zephyr/soc/amd/acp_6_0/Kconfig"
osource "C:/ncs/v3.2.0-preview2/zephyr/soc/ambiq/Kconfig"
osource "C:/ncs/v3.2.0-preview2/zephyr/soc/aesc/Kconfig"
osource "C:/ncs/v3.2.0-preview2/zephyr/soc/adi/max32/Kconfig"
osource "C:/ncs/v3.2.0-preview2/nrf/soc/sercomm/nrf91/Kconfig"
osource "C:/ncs/v3.2.0-preview2/nrf/soc/nordic/Kconfig"
```
