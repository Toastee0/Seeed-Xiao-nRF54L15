## led_strip/build_xiao/Kconfig/soc/Kconfig.sysbuild
```kconfig
# Load Sysbuild SoC Kconfig descriptions.
osource "C:/ncs/v3.1.1/zephyr/soc/xlnx/zynqmp/Kconfig.sysbuild"
osource "C:/ncs/v3.1.1/zephyr/soc/xlnx/zynq7000/Kconfig.sysbuild"
osource "C:/ncs/v3.1.1/zephyr/soc/xlnx/versalnet/Kconfig.sysbuild"
osource "C:/ncs/v3.1.1/zephyr/soc/xlnx/versal2/Kconfig.sysbuild"
osource "C:/ncs/v3.1.1/zephyr/soc/xen/Kconfig.sysbuild"
osource "C:/ncs/v3.1.1/zephyr/soc/wch/ch32v/Kconfig.sysbuild"
osource "C:/ncs/v3.1.1/zephyr/soc/ti/simplelink/Kconfig.sysbuild"
osource "C:/ncs/v3.1.1/zephyr/soc/ti/mspm0/Kconfig.sysbuild"
osource "C:/ncs/v3.1.1/zephyr/soc/ti/lm3s6965/Kconfig.sysbuild"
osource "C:/ncs/v3.1.1/zephyr/soc/ti/k3/Kconfig.sysbuild"
osource "C:/ncs/v3.1.1/zephyr/soc/telink/tlsr/Kconfig.sysbuild"
osource "C:/ncs/v3.1.1/zephyr/soc/starfive/jh71xx/Kconfig.sysbuild"
osource "C:/ncs/v3.1.1/zephyr/soc/st/stm32/Kconfig.sysbuild"
osource "C:/ncs/v3.1.1/zephyr/soc/snps/qemu_arc/Kconfig.sysbuild"
osource "C:/ncs/v3.1.1/zephyr/soc/snps/nsim/arc_v/Kconfig.sysbuild"
osource "C:/ncs/v3.1.1/zephyr/soc/snps/nsim/arc_classic/Kconfig.sysbuild"
osource "C:/ncs/v3.1.1/zephyr/soc/snps/hsdk4xd/Kconfig.sysbuild"
osource "C:/ncs/v3.1.1/zephyr/soc/snps/hsdk/Kconfig.sysbuild"
osource "C:/ncs/v3.1.1/zephyr/soc/snps/emsk/Kconfig.sysbuild"
osource "C:/ncs/v3.1.1/zephyr/soc/snps/emsdp/Kconfig.sysbuild"
osource "C:/ncs/v3.1.1/zephyr/soc/snps/arc_iot/Kconfig.sysbuild"
osource "C:/ncs/v3.1.1/zephyr/soc/silabs/Kconfig.sysbuild"
osource "C:/ncs/v3.1.1/zephyr/soc/sifive/sifive_freedom/Kconfig.sysbuild"
osource "C:/ncs/v3.1.1/zephyr/soc/sensry/Kconfig.sysbuild"
osource "C:/ncs/v3.1.1/zephyr/soc/rockchip/Kconfig.sysbuild"
osource "C:/ncs/v3.1.1/zephyr/soc/renode/riscv_virtual/Kconfig.sysbuild"
osource "C:/ncs/v3.1.1/zephyr/soc/renode/cortex_r8_virtual/Kconfig.sysbuild"
osource "C:/ncs/v3.1.1/zephyr/soc/renesas/smartbond/Kconfig.sysbuild"
osource "C:/ncs/v3.1.1/zephyr/soc/renesas/rz/Kconfig.sysbuild"
osource "C:/ncs/v3.1.1/zephyr/soc/renesas/rx/Kconfig.sysbuild"
osource "C:/ncs/v3.1.1/zephyr/soc/renesas/rcar/Kconfig.sysbuild"
osource "C:/ncs/v3.1.1/zephyr/soc/renesas/ra/Kconfig.sysbuild"
osource "C:/ncs/v3.1.1/zephyr/soc/realtek/ec/Kconfig.sysbuild"
osource "C:/ncs/v3.1.1/zephyr/soc/raspberrypi/rpi_pico/Kconfig.sysbuild"
osource "C:/ncs/v3.1.1/zephyr/soc/quicklogic/eos_s3/Kconfig.sysbuild"
osource "C:/ncs/v3.1.1/zephyr/soc/qemu/virt_riscv/Kconfig.sysbuild"
osource "C:/ncs/v3.1.1/zephyr/soc/qemu/malta/Kconfig.sysbuild"
osource "C:/ncs/v3.1.1/zephyr/soc/openisa/rv32m1/Kconfig.sysbuild"
osource "C:/ncs/v3.1.1/zephyr/soc/openhwgroup/cva6/Kconfig.sysbuild"
osource "C:/ncs/v3.1.1/zephyr/soc/oct/osd32mp15x/Kconfig.sysbuild"
osource "C:/ncs/v3.1.1/zephyr/soc/nxp/s32/Kconfig.sysbuild"
osource "C:/ncs/v3.1.1/zephyr/soc/nxp/rw/Kconfig.sysbuild"
osource "C:/ncs/v3.1.1/zephyr/soc/nxp/mcx/Kconfig.sysbuild"
osource "C:/ncs/v3.1.1/zephyr/soc/nxp/lpc/Kconfig.sysbuild"
osource "C:/ncs/v3.1.1/zephyr/soc/nxp/layerscape/Kconfig.sysbuild"
osource "C:/ncs/v3.1.1/zephyr/soc/nxp/kinetis/Kconfig.sysbuild"
osource "C:/ncs/v3.1.1/zephyr/soc/nxp/imxrt/Kconfig.sysbuild"
osource "C:/ncs/v3.1.1/zephyr/soc/nxp/imx/Kconfig.sysbuild"
osource "C:/ncs/v3.1.1/zephyr/soc/nuvoton/numicro/Kconfig.sysbuild"
osource "C:/ncs/v3.1.1/zephyr/soc/nuvoton/numaker/Kconfig.sysbuild"
osource "C:/ncs/v3.1.1/zephyr/soc/nuvoton/npcx/Kconfig.sysbuild"
osource "C:/ncs/v3.1.1/zephyr/soc/nuvoton/npcm/Kconfig.sysbuild"
osource "C:/ncs/v3.1.1/zephyr/soc/nordic/Kconfig.sysbuild"
osource "C:/ncs/v3.1.1/zephyr/soc/neorv32/Kconfig.sysbuild"
osource "C:/ncs/v3.1.1/zephyr/soc/native/inf_clock/Kconfig.sysbuild"
osource "C:/ncs/v3.1.1/zephyr/soc/microchip/sam/Kconfig.sysbuild"
osource "C:/ncs/v3.1.1/zephyr/soc/microchip/miv/Kconfig.sysbuild"
osource "C:/ncs/v3.1.1/zephyr/soc/microchip/mec/Kconfig.sysbuild"
osource "C:/ncs/v3.1.1/zephyr/soc/mediatek/mt8xxx/Kconfig.sysbuild"
osource "C:/ncs/v3.1.1/zephyr/soc/lowrisc/opentitan/Kconfig.sysbuild"
osource "C:/ncs/v3.1.1/zephyr/soc/litex/litex_vexriscv/Kconfig.sysbuild"
osource "C:/ncs/v3.1.1/zephyr/soc/ite/ec/Kconfig.sysbuild"
osource "C:/ncs/v3.1.1/zephyr/soc/intel/raptor_lake/Kconfig.sysbuild"
osource "C:/ncs/v3.1.1/zephyr/soc/intel/lakemont/Kconfig.sysbuild"
osource "C:/ncs/v3.1.1/zephyr/soc/intel/intel_socfpga_std/Kconfig.sysbuild"
osource "C:/ncs/v3.1.1/zephyr/soc/intel/intel_socfpga/Kconfig.sysbuild"
osource "C:/ncs/v3.1.1/zephyr/soc/intel/intel_niosv/Kconfig.sysbuild"
osource "C:/ncs/v3.1.1/zephyr/soc/intel/intel_ish/Kconfig.sysbuild"
osource "C:/ncs/v3.1.1/zephyr/soc/intel/intel_adsp/Kconfig.sysbuild"
osource "C:/ncs/v3.1.1/zephyr/soc/intel/elkhart_lake/Kconfig.sysbuild"
osource "C:/ncs/v3.1.1/zephyr/soc/intel/atom/Kconfig.sysbuild"
osource "C:/ncs/v3.1.1/zephyr/soc/intel/apollo_lake/Kconfig.sysbuild"
osource "C:/ncs/v3.1.1/zephyr/soc/intel/alder_lake/Kconfig.sysbuild"
osource "C:/ncs/v3.1.1/zephyr/soc/infineon/cat3/Kconfig.sysbuild"
osource "C:/ncs/v3.1.1/zephyr/soc/infineon/cat1c/Kconfig.sysbuild"
osource "C:/ncs/v3.1.1/zephyr/soc/infineon/cat1b/Kconfig.sysbuild"
osource "C:/ncs/v3.1.1/zephyr/soc/infineon/cat1a/Kconfig.sysbuild"
osource "C:/ncs/v3.1.1/zephyr/soc/gd/gd32/Kconfig.sysbuild"
osource "C:/ncs/v3.1.1/zephyr/soc/gaisler/leon3/Kconfig.sysbuild"
osource "C:/ncs/v3.1.1/zephyr/soc/gaisler/gr716a/Kconfig.sysbuild"
osource "C:/ncs/v3.1.1/zephyr/soc/espressif/Kconfig.sysbuild"
osource "C:/ncs/v3.1.1/zephyr/soc/ene/kb1200/Kconfig.sysbuild"
osource "C:/ncs/v3.1.1/zephyr/soc/efinix/sapphire/Kconfig.sysbuild"
osource "C:/ncs/v3.1.1/zephyr/soc/cdns/xtensa_sample_controller/Kconfig.sysbuild"
osource "C:/ncs/v3.1.1/zephyr/soc/cdns/sample_controller32/Kconfig.sysbuild"
osource "C:/ncs/v3.1.1/zephyr/soc/cdns/dc233c/Kconfig.sysbuild"
osource "C:/ncs/v3.1.1/zephyr/soc/brcm/bcmvk/Kconfig.sysbuild"
osource "C:/ncs/v3.1.1/zephyr/soc/brcm/bcm2712/Kconfig.sysbuild"
osource "C:/ncs/v3.1.1/zephyr/soc/brcm/bcm2711/Kconfig.sysbuild"
osource "C:/ncs/v3.1.1/zephyr/soc/bflb/Kconfig.sysbuild"
osource "C:/ncs/v3.1.1/zephyr/soc/atmel/sam0/Kconfig.sysbuild"
osource "C:/ncs/v3.1.1/zephyr/soc/atmel/sam/Kconfig.sysbuild"
osource "C:/ncs/v3.1.1/zephyr/soc/aspeed/Kconfig.sysbuild"
osource "C:/ncs/v3.1.1/zephyr/soc/arm/Kconfig.sysbuild"
osource "C:/ncs/v3.1.1/zephyr/soc/arm/beetle/Kconfig.sysbuild"
osource "C:/ncs/v3.1.1/zephyr/soc/antmicro/myra/Kconfig.sysbuild"
osource "C:/ncs/v3.1.1/zephyr/soc/andestech/Kconfig.sysbuild"
osource "C:/ncs/v3.1.1/zephyr/soc/amd/acp_6_0/Kconfig.sysbuild"
osource "C:/ncs/v3.1.1/zephyr/soc/ambiq/Kconfig.sysbuild"
osource "C:/ncs/v3.1.1/zephyr/soc/aesc/Kconfig.sysbuild"
osource "C:/ncs/v3.1.1/zephyr/soc/adi/max32/Kconfig.sysbuild"
osource "C:/ncs/v3.1.1/nrf/soc/sercomm/nrf91/Kconfig.sysbuild"
osource "C:/ncs/v3.1.1/nrf/soc/nordic/Kconfig.sysbuild"
```

## pwm/build_xiao/Kconfig/boards/Kconfig
```kconfig
# Load Zephyr board Kconfig descriptions.
osource "C:/ncs/v3.1.0/zephyr/boards/arm/xiao_nrf54l15/Kconfig"
```

## pwm/build_xiao/Kconfig/boards/Kconfig.defconfig
```kconfig
# Load Zephyr board defconfig descriptions.
osource "C:/ncs/v3.1.0/zephyr/boards/arm/xiao_nrf54l15/Kconfig.defconfig"
```

## xiao_expanded/grove_relay/sample.yaml
```yaml
sample:
  name: GPIO Button to Relay Control
  description: Button press controls relay output demonstrating GPIO input/output operations
tests:
  sample.gpio.button_relay:
    harness: console
    platform_allow:
      - xiao_nrf54l15/nrf54l15/cpuapp
    tags: gpio button relay input output
    integration_platforms:
      - xiao_nrf54l15/nrf54l15/cpuapp
```

## zephyr-adc-ncs/sample.yaml
```yaml
sample:
  name: ADC to PWM Control
  description: ADC potentiometer reading controls PWM LED brightness
tests:
  sample.adc.pwm_control:
    harness: console
    platform_allow:
      - nrf52840dk/nrf52840
      - nrf5340dk/nrf5340/cpuapp
      - xiao_nrf54l15/nrf54l15/cpuapp
    tags: adc pwm sensors
    integration_platforms:
      - xiao_nrf54l15/nrf54l15/cpuapp
```

## zephyr-ble-ncs/sample.yaml
```yaml
sample:
  name: Bluetooth BLE Peripheral
  description: BLE peripheral with custom GATT service
tests:
  sample.bluetooth.peripheral:
    harness: bluetooth
    platform_allow:
      - nrf52840dk/nrf52840
      - nrf5340dk/nrf5340/cpuapp
      - xiao_nrf54l15/nrf54l15/cpuapp
    tags: bluetooth
    integration_platforms:
      - nrf52840dk/nrf52840
```

## zephyr-button-ncs/sample.yaml
```yaml
sample:
  name: Button to LED Control
  description: Button press controls LED state demonstrating GPIO input and output
tests:
  sample.basic.button:
    harness: console
    platform_allow:
      - nrf52840dk/nrf52840
      - nrf5340dk/nrf5340/cpuapp
      - xiao_nrf54l15/nrf54l15/cpuapp
    tags: gpio button led input output
    integration_platforms:
      - xiao_nrf54l15/nrf54l15/cpuapp
```

## zephyr-dmic-recorder-ncs/sample.yaml
```yaml
sample:
  name: DMIC Audio Recorder
  description: Digital microphone recording sample with UART streaming
tests:
  sample.audio.dmic_recorder:
    harness: console
    platform_allow:
      - nrf52840dk/nrf52840
      - nrf5340dk/nrf5340/cpuapp
      - xiao_nrf54l15/nrf54l15/cpuapp
    tags: audio dmic uart streaming
    integration_platforms:
      - xiao_nrf54l15/nrf54l15/cpuapp
```

## zephyr-expansion-base-for-xiao/zephyr-expansion-oled-ncs/sample.yaml
```yaml
sample:
  name: Expansion Board OLED Display
  description: SSD1306 OLED display sample using character framebuffer
tests:
  sample.display.expansion_oled:
    harness: console
    platform_allow:
      - nrf52840dk/nrf52840
      - nrf5340dk/nrf5340/cpuapp
      - xiao_nrf54l15/nrf54l15/cpuapp
    tags: display oled i2c expansion ssd1306
    integration_platforms:
      - xiao_nrf54l15/nrf54l15/cpuapp
```

## zephyr-lowpower-ncs/sample.yaml
```yaml
sample:
  name: Low Power System Off
  description: Power management sample demonstrating system off mode and wake-up
tests:
  sample.power.system_off:
    harness: console
    platform_allow:
      - nrf52840dk/nrf52840
      - nrf5340dk/nrf5340/cpuapp
      - xiao_nrf54l15/nrf54l15/cpuapp
    tags: power system-off wake-up button
    integration_platforms:
      - xiao_nrf54l15/nrf54l15/cpuapp
```
